## meta-add-service/conf/layer.conf
```bitbake
# We have a conf and classes directory, add to BBPATH
BBPATH .= ":${LAYERDIR}"

# We have recipes-* directories, add to BBFILES
BBFILES += "${LAYERDIR}/recipes-*/*/*.bb \
            ${LAYERDIR}/recipes-*/*/*.bbappend"

BBFILE_COLLECTIONS += "meta-add-service"
BBFILE_PATTERN_meta-add-service = "^${LAYERDIR}/"
BBFILE_PRIORITY_meta-add-service = "6"

LAYERDEPENDS_meta-add-service = "core"
LAYERSERIES_COMPAT_meta-add-service = "kirkstone"
```

## meta-add-user-Ok/conf/layer.conf
```bitbake
# We have a conf and classes directory, add to BBPATH
BBPATH .= ":${LAYERDIR}"

# We have recipes-* directories, add to BBFILES
BBFILES += "${LAYERDIR}/recipes-*/*/*.bb \
            ${LAYERDIR}/recipes-*/*/*.bbappend"

BBFILE_COLLECTIONS += "meta-add-user"
BBFILE_PATTERN_meta-add-user = "^${LAYERDIR}/"
BBFILE_PRIORITY_meta-add-user = "6"

LAYERDEPENDS_meta-add-user = "core"
LAYERSERIES_COMPAT_meta-add-user = "kirkstone"
```

## meta-agnes/conf/distro/Agnes.conf
```bitbake
require conf/distro/fsl-imx-wayland.conf
DISTROOVERRIDES = "fsl-imx-wayland"
DISTRO = "Agnes"
```

## meta-agnes/conf/distro/agnes.conf
```bitbake
# This is an example distro conf. Here is where you can customize the
# policies about how your embedded Linux system should be
# configured. Writing one is so simple that it does not make sense to not
# do it.

require conf/distro/fsl-imx-wayland.conf
DISTROOVERRIDES = "fsl-imx-wayland"

DISTRO_NAME = "Agnes Linux (Better organization for Custom images.)"
DISTRO = "agnes"
DISTRO_VERSION = "1.0"

# Set features we want on all Agnes devices. Also disables any features not
# explicitly mentioned.
DISTRO_FEATURES:append = " \
                            ipv4 \
                            ipv6 \
                            systemd \
                            usbgadget \
                            usbhost \
                            wifi \
                            zeroconf \
                        "

# Choose right Wifi firmware
PREFERRED_RPROVIDER_linux-firmware-bcm4359-pcie = "firmware-nxp-wifi"

# Set Systemd as Init manager software
INIT_MANAGER = "systemd"
```

## meta-agnes/conf/layer.conf
```bitbake
# We have a conf and classes directory, add to BBPATH
BBPATH .= ":${LAYERDIR}"

# We have recipes-* directories, add to BBFILES
BBFILES += "${LAYERDIR}/recipes-*/*/*.bb \
            ${LAYERDIR}/recipes-*/*/*.bbappend"

BBFILE_COLLECTIONS += "meta-agnes"
BBFILE_PATTERN_meta-agnes = "^${LAYERDIR}/"
BBFILE_PRIORITY_meta-agnes = "6"

LAYERDEPENDS_meta-agnes = "core"
LAYERSERIES_COMPAT_meta-agnes = "kirkstone"
```

## meta-blink/conf/layer.conf
```bitbake
# We have a conf and classes directory, add to BBPATH
BBPATH .= ":${LAYERDIR}"

# We have recipes-* directories, add to BBFILES
BBFILES += "${LAYERDIR}/recipes-*/*/*.bb \
            ${LAYERDIR}/recipes-*/*/*.bbappend"

BBFILE_COLLECTIONS += "meta-blink"
BBFILE_PATTERN_meta-blink = "^${LAYERDIR}/"
BBFILE_PRIORITY_meta-blink = "6"

LAYERDEPENDS_meta-blink = "core"
LAYERSERIES_COMPAT_meta-blink = "kirkstone"
```

## meta-custom-user/conf/layer.conf
```bitbake
# We have a conf and classes directory, add to BBPATH
BBPATH .= ":${LAYERDIR}"

# We have recipes-* directories, add to BBFILES
BBFILES += "${LAYERDIR}/recipes-*/*/*.bb \
            ${LAYERDIR}/recipes-*/*/*.bbappend"

BBFILE_COLLECTIONS += "meta-custom-user"
BBFILE_PATTERN_meta-custom-user = "^${LAYERDIR}/"
BBFILE_PRIORITY_meta-custom-user = "6"

LAYERDEPENDS_meta-custom-user = "core"
LAYERSERIES_COMPAT_meta-custom-user = "kirkstone"
```

## meta-gpio/conf/layer.conf
```bitbake
# We have a conf and classes directory, add to BBPATH
BBPATH .= ":${LAYERDIR}"

# We have recipes-* directories, add to BBFILES
BBFILES += "${LAYERDIR}/recipes-*/*/*.bb \
            ${LAYERDIR}/recipes-*/*/*.bbappend"

BBFILE_COLLECTIONS += "meta-gpio"
BBFILE_PATTERN_meta-gpio = "^${LAYERDIR}/"
BBFILE_PRIORITY_meta-gpio = "6"

LAYERDEPENDS_meta-gpio = "core"
LAYERSERIES_COMPAT_meta-gpio = "kirkstone"
```

## meta-gpiotoggle/conf/layer.conf
```bitbake
# We have a conf and classes directory, add to BBPATH
BBPATH .= ":${LAYERDIR}"

# We have recipes-* directories, add to BBFILES
BBFILES += "${LAYERDIR}/recipes-*/*/*.bb \
            ${LAYERDIR}/recipes-*/*/*.bbappend"

BBFILE_COLLECTIONS += "meta-gpiotoggle"
BBFILE_PATTERN_meta-gpiotoggle = "^${LAYERDIR}/"
BBFILE_PRIORITY_meta-gpiotoggle = "6"

LAYERDEPENDS_meta-gpiotoggle = "core"
LAYERSERIES_COMPAT_meta-gpiotoggle = "kirkstone"
```

## meta-heartbeat/conf/layer.conf
```bitbake
# We have a conf and classes directory, add to BBPATH
BBPATH .= ":${LAYERDIR}"

# We have recipes-* directories, add to BBFILES
BBFILES += "${LAYERDIR}/recipes-*/*/*.bb \
            ${LAYERDIR}/recipes-*/*/*.bbappend"

BBFILE_COLLECTIONS += "meta-heartbeat"
BBFILE_PATTERN_meta-heartbeat = "^${LAYERDIR}/"
BBFILE_PRIORITY_meta-heartbeat = "6"

LAYERDEPENDS_meta-heartbeat = "core"
LAYERSERIES_COMPAT_meta-heartbeat = "kirkstone"
```

## meta-imx8mnevk/conf/layer.conf
```bitbake
# We have a conf and classes directory, add to BBPATH
BBPATH .= ":${LAYERDIR}"

# We have recipes-* directories, add to BBFILES
BBFILES += "${LAYERDIR}/recipes-*/*/*.bb \
            ${LAYERDIR}/recipes-*/*/*.bbappend"

BBFILE_COLLECTIONS += "meta-imx8mnevk"
BBFILE_PATTERN_meta-imx8mnevk = "^${LAYERDIR}/"
BBFILE_PRIORITY_meta-imx8mnevk = "6"

LAYERDEPENDS_meta-imx8mnevk = "core"
LAYERSERIES_COMPAT_meta-imx8mnevk = "kirkstone"
```

## meta-libgpiod/conf/layer.conf
```bitbake
# We have a conf and classes directory, add to BBPATH
BBPATH .= ":${LAYERDIR}"

# We have recipes-* directories, add to BBFILES
BBFILES += "${LAYERDIR}/recipes-*/*/*.bb \
            ${LAYERDIR}/recipes-*/*/*.bbappend"

BBFILE_COLLECTIONS += "meta-libgpiod"
BBFILE_PATTERN_meta-libgpiod = "^${LAYERDIR}/"
BBFILE_PRIORITY_meta-libgpiod = "6"

LAYERDEPENDS_meta-libgpiod = "core"
LAYERSERIES_COMPAT_meta-libgpiod = "kirkstone"
```

## meta-publish/conf/layer.conf
```bitbake
# We have a conf and classes directory, add to BBPATH
BBPATH .= ":${LAYERDIR}"

# We have recipes-* directories, add to BBFILES
BBFILES += "${LAYERDIR}/recipes-*/*/*.bb \
            ${LAYERDIR}/recipes-*/*/*.bbappend"

BBFILE_COLLECTIONS += "meta-publish"
BBFILE_PATTERN_meta-publish = "^${LAYERDIR}/"
BBFILE_PRIORITY_meta-publish = "6"

LAYERDEPENDS_meta-publish = "core"
LAYERSERIES_COMPAT_meta-publish = "kirkstone"
```

## meta-spidev-ili9341/conf/layer.conf
```bitbake
# We have a conf and classes directory, add to BBPATH
BBPATH .= ":${LAYERDIR}"

# We have recipes-* directories, add to BBFILES
BBFILES += "${LAYERDIR}/recipes-*/*/*.bb \
            ${LAYERDIR}/recipes-*/*/*.bbappend"

BBFILE_COLLECTIONS += "meta-spidev-ili9341"
BBFILE_PATTERN_meta-spidev-ili9341 = "^${LAYERDIR}/"
BBFILE_PRIORITY_meta-spidev-ili9341 = "6"

LAYERDEPENDS_meta-spidev-ili9341 = "core"
LAYERSERIES_COMPAT_meta-spidev-ili9341 = "kirkstone"
```

## meta-ssd1306/conf/layer.conf
```bitbake
# We have a conf and classes directory, add to BBPATH
BBPATH .= ":${LAYERDIR}"

# We have recipes-* directories, add to BBFILES
BBFILES += "${LAYERDIR}/recipes-*/*/*.bb \
            ${LAYERDIR}/recipes-*/*/*.bbappend"

BBFILE_COLLECTIONS += "meta-ssd1306"
BBFILE_PATTERN_meta-ssd1306 = "^${LAYERDIR}/"
BBFILE_PRIORITY_meta-ssd1306 = "6"

LAYERDEPENDS_meta-ssd1306 = "core"
LAYERSERIES_COMPAT_meta-ssd1306 = "kirkstone"
```

## meta-templm75a-bsp/conf/layer.conf
```bitbake
# We have a conf and classes directory, add to BBPATH
BBPATH .= ":${LAYERDIR}"

# We have recipes-* directories, add to BBFILES
BBFILES += "${LAYERDIR}/recipes-*/*/*.bb \
            ${LAYERDIR}/recipes-*/*/*.bbappend"

BBFILE_COLLECTIONS += "meta-templm75a-bsp"
BBFILE_PATTERN_meta-templm75a-bsp = "^${LAYERDIR}/"
BBFILE_PRIORITY_meta-templm75a-bsp = "6"

LAYERDEPENDS_meta-templm75a-bsp = "core"
LAYERSERIES_COMPAT_meta-templm75a-bsp = "kirkstone"
```

## meta-utils/conf/layer.conf
```bitbake
# We have a conf and classes directory, add to BBPATH
BBPATH .= ":${LAYERDIR}"

# We have recipes-* directories, add to BBFILES
BBFILES += "${LAYERDIR}/recipes-*/*/*.bb \
            ${LAYERDIR}/recipes-*/*/*.bbappend"

BBFILE_COLLECTIONS += "meta-utils"
BBFILE_PATTERN_meta-utils = "^${LAYERDIR}/"
BBFILE_PRIORITY_meta-utils = "6"

LAYERDEPENDS_meta-utils = "core"
LAYERSERIES_COMPAT_meta-utils = "kirkstone"
```

## meta.old-Ok/meta-networking/conf/layer.conf
```bitbake
# We have a conf and classes directory, add to BBPATH
BBPATH .= ":${LAYERDIR}"

# We have recipes-* directories, add to BBFILES
BBFILES += "${LAYERDIR}/recipes-*/*/*.bb \
            ${LAYERDIR}/recipes-*/*/*.bbappend"

BBFILE_COLLECTIONS += "meta-networking"
BBFILE_PATTERN_meta-networking = "^${LAYERDIR}/"
BBFILE_PRIORITY_meta-networking = "6"

LAYERDEPENDS_meta-networking = "core"
LAYERSERIES_COMPAT_meta-networking = "kirkstone"
```
